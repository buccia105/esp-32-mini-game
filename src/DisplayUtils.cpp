#include "DisplayUtils.h"
#include <cstdint>

// display configuration
const uint8_t DISP_ADDR = 0x3D;
Adafruit_SSD1306 display(SCREEN_WIDTH, SCREEN_HEIGHT, &Wire, -1);

// ICONS
// weather icons
static const unsigned char PROGMEM image_cloud_bits[] = {
    0x00, 0x00, 0x00, 0x07, 0xc0, 0x00, 0x08, 0x20, 0x00, 0x10, 0x10, 0x00,
    0x30, 0x08, 0x00, 0x40, 0x0e, 0x00, 0x80, 0x01, 0x00, 0x80, 0x00, 0x80,
    0x40, 0x00, 0x80, 0x3f, 0xff, 0x00, 0x00, 0x00, 0x00, 0x00, 0x00, 0x00,
    0x00, 0x00, 0x00, 0x00, 0x00, 0x00, 0x00, 0x00, 0x00, 0x00, 0x00, 0x00};

static const unsigned char PROGMEM image_weather_cloud_rain_bits[] = {
    0x00, 0x00, 0x00, 0x07, 0xc0, 0x00, 0x08, 0x20, 0x00, 0x10, 0x10, 0x00,
    0x30, 0x08, 0x00, 0x40, 0x0e, 0x00, 0x80, 0x01, 0x00, 0x80, 0x00, 0x80,
    0x40, 0x00, 0x80, 0x3f, 0xff, 0x00, 0x01, 0x10, 0x00, 0x22, 0x22, 0x00,
    0x44, 0x84, 0x00, 0x91, 0x28, 0x00, 0x22, 0x40, 0x00, 0x00, 0x80, 0x00};

static const unsigned char PROGMEM image_weather_cloud_sunny_bits[] = {
    0x00, 0x20, 0x00, 0x02, 0x02, 0x00, 0x00, 0x70, 0x00, 0x01, 0x8c, 0x00,
    0x09, 0x04, 0x80, 0x02, 0x02, 0x00, 0x02, 0x02, 0x00, 0x07, 0x82, 0x00,
    0x08, 0x44, 0x80, 0x10, 0x2c, 0x00, 0x30, 0x30, 0x00, 0x60, 0x1e, 0x00,
    0x80, 0x03, 0x00, 0x80, 0x01, 0x00, 0x80, 0x01, 0x00, 0x7f, 0xfe, 0x00};

static const unsigned char PROGMEM image_weather_humidity_bits[] = {
    0x04, 0x00, 0x04, 0x00, 0x0c, 0x00, 0x0e, 0x00, 0x1e, 0x00, 0x1f,
    0x00, 0x3f, 0x80, 0x3f, 0x80, 0x7e, 0xc0, 0x7f, 0x40, 0xff, 0x60,
    0xff, 0xe0, 0x7f, 0xc0, 0x7f, 0xc0, 0x3f, 0x80, 0x0f, 0x00};

static const unsigned char PROGMEM image_weather_sun_bits[] = {
    0x01, 0x00, 0x21, 0x08, 0x10, 0x10, 0x03, 0x80, 0x8c, 0x62, 0x48,
    0x24, 0x10, 0x10, 0x10, 0x10, 0x10, 0x10, 0x48, 0x24, 0x8c, 0x62,
    0x03, 0x80, 0x10, 0x10, 0x21, 0x08, 0x01, 0x00, 0x00, 0x00};

static const unsigned char PROGMEM image_weather_temperature_bits[] = {
    0x1c, 0x00, 0x22, 0x02, 0x2b, 0x05, 0x2a, 0x02, 0x2b, 0x38, 0x2a,
    0x60, 0x2b, 0x40, 0x2a, 0x40, 0x2a, 0x60, 0x49, 0x38, 0x9c, 0x80,
    0xae, 0x80, 0xbe, 0x80, 0x9c, 0x80, 0x41, 0x00, 0x3e, 0x00};

    
// menu icons
static const unsigned char PROGMEM snake_menu_bits[] = {
    0x00, 0x00, 0x00, 0x00, 0x00, 0x00, 0x01, 0x80, 0x00, 0x00, 0x1f, 0x00,
    0x00, 0x00, 0x33, 0x00, 0x00, 0x00, 0x21, 0x00, 0x00, 0x00, 0x63, 0x00,
    0x00, 0x00, 0xce, 0x00, 0x1f, 0x80, 0x9c, 0x00, 0x38, 0xc1, 0xb0, 0x00,
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    0x07, 0xe0, 0x00, 0x00};

static const unsigned char PROGMEM score_menu_bits[] = {
    0x00, 0x00, 0x00, 0x00, 0x00, 0x00, 0x00, 0x00, 0x00, 0x40, 0x80, 0x00,
    0x08, 0x40, 0x84, 0x00, 0x04, 0x40, 0x88, 0x00, 0x00, 0x00, 0x00, 0x00,
    0x00, 0x00, 0x00, 0x00, 0x71, 0xff, 0xe3, 0x00, 0x01, 0xff, 0xe0, 0x00,
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    0x00, 0x40, 0x80, 0x00};

static const unsigned char PROGMEM weather_menu_bits[] = {
    0x00, 0x00, 0x00, 0x00, 0x09, 0x20, 0x06, 0x00, 0x08, 0x40, 0x09, 0x00,
    0x03, 0x80, 0x11, 0x00, 0x34, 0x50, 0x1f, 0x00, 0x08, 0x2e, 0x11, 0x00,
    0x68, 0x31, 0x11, 0x00, 0x08, 0x46, 0x91, 0x00, 0x08, 0x41, 0x51, 0x00,
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    0x49, 0x65, 0xa0, 0x00};

// array for menu items
const unsigned char *menu_icons[3] = {score_menu_bits, snake_menu_bits,
                                      weather_menu_bits};


// DISPLAY FUNCTIONS
// display initialization
void initDisplay() {
  if (!display.begin(SSD1306_SWITCHCAPVCC, DISP_ADDR)) {
    Serial.println(F("SSD1306 allocation failed"));
    for (;;)
      ;
  }
  display.clearDisplay();
  display.display();
}

// turn off display
void turnOffDisplay() {
  display.clearDisplay();
  display.display();
  display.ssd1306_command(SSD1306_DISPLAYOFF);
}


// SCREENS
// shutdown message
/**
  * @brief draws a shutdown pop-up
  */
void drawShutdownScreen() {
  display.clearDisplay();
  display.setTextColor(SSD1306_WHITE);
  display.setTextSize(1);
  display.setTextWrap(false);

  display.setCursor(14, 25);
  display.print("going to sleep...");

  display.setCursor(11, 33);
  display.print("release to turn off");

  display.display();
}

// wakeup message
/**
  * @brief draws a wakeup message
  */
void drawWakeupScreen() {
  display.clearDisplay();
  display.setTextColor(SSD1306_WHITE);

  display.setTextSize(2);
  display.setTextWrap(false);
  display.setCursor(17, 10);
  display.print("WELCOME!");

  display.setTextSize(1);
  display.setCursor(35, 33);
  display.print("created by");
  display.setCursor(26, 45);
  display.print("Buccia & Fior");

  display.display();
}

// main manu
/**
  * @brief draws menu UI.
  *
  * @param selectedIndex is the index of the currently selected app. 
  */
void drawMenu(int selectedIndex) {
  display.clearDisplay();

  int boxSize = 35;
  int iconSize = 25;
  int spacing = 6;
  int startX = 5;
  int startY = 14;
  int iconOffset = 5; 

  for (int i = 0; i < 3; i++) {
    int xPos = startX + (i * (boxSize + spacing));

    if (i == selectedIndex) {
      // inverting icon colors for the selected item
      display.fillRect(xPos, startY, boxSize, boxSize, SSD1306_WHITE);
      display.drawBitmap(xPos + iconOffset, startY + iconOffset, menu_icons[i],
                         iconSize, iconSize, SSD1306_BLACK);
    } else {
      // unselected drawing white rectangle
      display.drawRect(xPos, startY, boxSize, boxSize, SSD1306_WHITE);
      display.drawBitmap(xPos + iconOffset, startY + iconOffset, menu_icons[i],
                         iconSize, iconSize, SSD1306_WHITE);
    }
  }

  display.display();
}

// weather app
/**
  * @brief draws appropriate icons for the weather status.
  *
  * @param x the starting X coordinate on the display (0-127).
  * @param y the starting Y coordinate on the display (0-63).
  * @param condition the text condition returned by the API. 
  */
void drawWeatherStatusIcon(int x, int y, String condition) {
  //mapping openweathermap API to a single or more icons
  if (condition == "Clear") {
    display.drawBitmap(x, y, image_weather_sun_bits, 16, 16, SSD1306_WHITE);
  } else if (condition == "Clouds") {
    // Usiamo l'icona con sole e nuvola per "Clouds"
    display.drawBitmap(x, y, image_weather_cloud_sunny_bits, 24, 16,
                       SSD1306_WHITE);
  } else if (condition == "Rain" || condition == "Drizzle" ||
             condition == "Thunderstorm") {
    display.drawBitmap(x, y, image_weather_cloud_rain_bits, 24, 16,
                       SSD1306_WHITE);
  } else if (condition == "Mist" || condition == "Fog" || condition == "Haze") {
    display.drawBitmap(x, y, image_cloud_bits, 24, 16, SSD1306_WHITE);
  } else {
    // Icona di default (nuvola generica) per stati non gestiti (es. Snow)
    display.drawBitmap(x, y, image_cloud_bits, 24, 16, SSD1306_WHITE);
  }
}